## conf/layer.conf
```bitbake
# We have a conf and classes directory, append to BBPATH
BBPATH .= ":${LAYERDIR}"

# We have a recipes directory containing .bb and .bbappend files, add to BBFILES
BBFILES += "${LAYERDIR}/recipes*/*/*.bb \
            ${LAYERDIR}/recipes*/*/*.bbappend"

BBFILE_COLLECTIONS += "xt-rpi5-prod-devel"
BBFILE_PATTERN_xt-rpi5-prod-devel := "^${LAYERDIR}/"
BBFILE_PRIORITY_xt-rpi5-prod-devel = "16"

LAYERSERIES_COMPAT_xt-rpi5-prod-devel = "scarthgap"
LAYERDEPENDS_xt-rpi5-prod-devel = "core xt-security xt-rpi5"
```

## layers/xt-prod-devel-rpi5-domu/conf/layer.conf
```bitbake
# We have a conf and classes directory, append to BBPATH
BBPATH .= ":${LAYERDIR}"

# We have a recipes directory containing .bb and .bbappend files, add to BBFILES
BBFILES += "${LAYERDIR}/recipes*/*/*.bb \
            ${LAYERDIR}/recipes*/*/*.bbappend"

BBFILE_COLLECTIONS += "xt-prod-devel-rpi5-domu"
BBFILE_PATTERN_xt-prod-devel-rpi5-domu := "^${LAYERDIR}/"
BBFILE_PRIORITY_xt-prod-devel-rpi5-domu = "16"

LAYERSERIES_COMPAT_xt-prod-devel-rpi5-domu = "scarthgap"
LAYERDEPENDS_xt-prod-devel-rpi5-domu = "core"
```

## meta-xt-prod-devel-rpi-control/conf/layer.conf
```bitbake
# We have a conf and classes directory, add to BBPATH
BBPATH .= ":${LAYERDIR}"

# We have a packages directory, add to BBFILES
BBFILES += "${LAYERDIR}/recipes-*/*/*.bb \
            ${LAYERDIR}/recipes-*/*/*.bbappend"

BBFILE_COLLECTIONS += "xt-prod-devel-rpi-control"
BBFILE_PATTERN_xt-prod-devel-rpi-control := "^${LAYERDIR}/"
BBFILE_PRIORITY_xt-prod-devel-rpi-control = "12"

LAYERSERIES_COMPAT_xt-prod-devel-rpi-control = "kirkstone scarthgap"
```

## xt-prod-devel-rpi5-domd/conf/layer.conf
```bitbake
# We have a conf and classes directory, append to BBPATH
BBPATH .= ":${LAYERDIR}"

# We have a recipes directory containing .bb and .bbappend files, add to BBFILES
BBFILES += "${LAYERDIR}/recipes*/*/*.bb \
            ${LAYERDIR}/recipes*/*/*.bbappend"

BBFILE_COLLECTIONS += "xt-prod-devel-rpi5-domd"
BBFILE_PATTERN_xt-prod-devel-rpi5-domd := "^${LAYERDIR}/"
BBFILE_PRIORITY_xt-prod-devel-rpi5-domd = "16"

LAYERSERIES_COMPAT_xt-prod-devel-rpi5-domd = "scarthgap"
LAYERDEPENDS_xt-prod-devel-rpi5-domd = "core xt-security xt-rpi5"
```
